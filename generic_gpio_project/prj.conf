## CMakeLists.txt
```
cmake_minimum_required(VERSION 3.20.0)

find_package(Zephyr REQUIRED HINTS $ENV{ZEPHYR_BASE})

project(generic_gpio_project)

target_sources(app PRIVATE src/main.c)
```

## Kconfig
```
mainmenu "Generic GPIO application"

source "Kconfig.zephyr"
```

## prj.conf
```kconfig
# No Zephyr GPIO API is used by this example.
CONFIG_GPIO=n
```

## src/main.c
```c
#include <stdint.h>

#if defined(CONFIG_BOARD_STM32F4_DISCO)
#include "stm32f407_gpio.h"
#elif defined(CONFIG_BOARD_LPC2129)
#include "lpc2129_gpio.h"
#else
#error "Unsupported board: select an implementation for this board"
#endif

int main(void)
{
    led_init();

    while (1) {
        led_toggle();
        delay();
    }

    return 0;
}
```

## src/lpc2129_gpio.h
```c
#ifndef LPC2129_GPIO_H
#define LPC2129_GPIO_H

#include <stdint.h>

/*
 * LPC2129 example: P0.10 configured as GPIO output.
 * Connect an LED (with a suitable current-limiting resistor) to P0.10
 * according to your board's wiring and LED polarity.
 */
#define PINSEL0  (*(volatile uint32_t *)0xE002C000U)
#define IO0DIR   (*(volatile uint32_t *)0xE0028008U)
#define IO0SET   (*(volatile uint32_t *)0xE0028004U)
#define IO0CLR   (*(volatile uint32_t *)0xE002800CU)

#define LED_PIN  (1U << 10)

static inline void led_init(void)
{
    /* PINSEL0 bits [21:20] = 00 selects GPIO for P0.10. */
    PINSEL0 &= ~(3U << 20);

    /* Configure P0.10 as output. */
    IO0DIR |= LED_PIN;
}

static inline void led_toggle(void)
{
    static uint8_t state;

    if (state) {
        IO0CLR = LED_PIN;
        state = 0U;
    } else {
        IO0SET = LED_PIN;
        state = 1U;
    }
}

static inline void delay(void)
{
    volatile uint32_t count = 2000000U;

    while (count--) {
        __asm__ volatile ("nop");
    }
}

#endif /* LPC2129_GPIO_H */
```

## src/stm32f407_gpio.h
```c
#ifndef STM32F407_GPIO_H
#define STM32F407_GPIO_H

#include <stdint.h>

/*
 * STM32F407 Discovery: green user LED is connected to PD12.
 * Register addresses are from the STM32F407 reference manual.
 */
#define RCC_AHB1ENR  (*(volatile uint32_t *)0x40023830U)
#define GPIOD_MODER  (*(volatile uint32_t *)0x40020C00U)
#define GPIOD_ODR    (*(volatile uint32_t *)0x40020C14U)

#define LED_PIN      (1U << 12)

static inline void led_init(void)
{
    /* Enable the GPIOD peripheral clock. */
    RCC_AHB1ENR |= (1U << 3);

    /* Set PD12 MODER bits to 01 (general-purpose output). */
    GPIOD_MODER &= ~(3U << 24);
    GPIOD_MODER |=  (1U << 24);
}

static inline void led_toggle(void)
{
    GPIOD_ODR ^= LED_PIN;
}

static inline void delay(void)
{
    volatile uint32_t count = 2000000U;

    while (count--) {
        __asm__ volatile ("nop");
    }
}

#endif /* STM32F407_GPIO_H */
```
